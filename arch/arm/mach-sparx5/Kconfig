## arch/arm/mach-sparx5/Kconfig
```kconfig
if ARCH_SPARX5

choice
	prompt "FireAnt DDR type"

config DDR_FIREANT_PCB125
	bool "FireAnt Modular board, 4Gb"

config DDR_FIREANT_PCB134
	bool "FireAnt Reference Board PCB134"

config DDR_FIREANT_PCB135
	bool "FireAnt Reference Board PCB135"

endchoice

config SYS_SDRAM_SIZE
        hex "Size of SDRAM"
	default 0x80000000

config DDR_FIREANT_CLK_DIV
        int
	default 8 if DDR_FIREANT_PCB125
	default 8 if DDR_FIREANT_PCB134
	default 6 if DDR_FIREANT_PCB135
	help
	 FireAnt DDR speed clock divisor:
		4: 625MHz
		5: 500MHz
		6: 416.667MHz
		8: 312.5MHz
		10: 250MHz
		12: 208.33MHz
		16: 156.25MHz
		20: 125MHz"

config DDR_FIREANT_16BIT
	bool "Enable 16 bit DDR interfaces"
	default n
	help
	 This forces a 16bit DDR interface. This option is provided
	 only for test purposes with the normal DDR types used. When
	 used with proper DDR configuration files for real 16bit
	 devices, this option should be disabled. When used, the DDR
	 memory size must typically be reduced to half the actuak
	 size. This option also forces disabling of ECC.

config FIREANT_SYMREG
	bool "Enable symbolic register access"
	default n

config TARGET_FIREANT_REAL
	bool "FireAnt raw metal"
	default y

source "board/microchip/sparx5/Kconfig"

endif
```

## board/Marvell/common/Kconfig
```kconfig
menu "Marvell Armada common configuration"
depends on TARGET_MVEBU_ARMADA_37XX || TARGET_MVEBU_ARMADA_8K

config MVEBU_MAC_HW_INFO
	bool "Marvell hw_info (mac) support"
	depends on SPI_FLASH && ENV_IS_IN_SPI_FLASH && ARCH_MVEBU
	default n
	help
	  Enable loading of the Marvell hw_info parameters from the
	  SPI flash hw_info area. Parameters (usually the board serial
	  number and MAC addresses) are then imported into the
	  existing U-Boot environment.
	  Implementation of this command is compatible with the
	  original Marvell U-Boot command. Reading and writing is
	  supported.
	  EEPROM config pattern and checksum aren't supported.
	  After enabled, these parameters are managed from the common
	  U-Boot mac command.

endmenu
```

## board/microchip/sparx5/Kconfig
```kconfig
if ARCH_SPARX5

config SYS_BOARD
	default "sparx5"

config SYS_VENDOR
	default "microchip"

config SYS_SOC
	default "sparx5"

config SYS_CONFIG_NAME
	default "sparx5"

endif
```

## configs/access-5.0_defconfig
```kconfig
CONFIG_ARM=y
CONFIG_SYS_ARCH_TIMER=y
CONFIG_SYS_THUMB_BUILD=y
CONFIG_ARCH_IPQ40XX=y
CONFIG_SYS_MALLOC_LEN=0x1000000
CONFIG_HAS_CUSTOM_SYS_INIT_SP_ADDR=y
CONFIG_CUSTOM_SYS_INIT_SP_ADDR=0x87400000
CONFIG_ENV_SIZE=0x00010000
CONFIG_ENV_OFFSET=0x000e0000
CONFIG_ENV_SECT_SIZE=0x00010000
CONFIG_DEFAULT_DEVICE_TREE="qcom-ipq4019-access-5-0"
CONFIG_DEBUG_UART_BASE=0x78af000
CONFIG_DEBUG_UART_CLOCK=1843200
CONFIG_SYS_LOAD_ADDR=0x84000000
CONFIG_DEBUG_UART=y
CONFIG_LTO=y
CONFIG_FIT=y
CONFIG_FIT_VERBOSE=y
# CONFIG_BOOTSTD is not set
CONFIG_SYS_BOOTM_LEN=0x4000000
# CONFIG_DISPLAY_CPUINFO is not set
CONFIG_LAST_STAGE_INIT=y
# CONFIG_BOOTM_NETBSD is not set
# CONFIG_BOOTM_PLAN9 is not set
# CONFIG_BOOTM_RTEMS is not set
# CONFIG_BOOTM_VXWORKS is not set
CONFIG_CMD_GPIO=y
CONFIG_CMD_I2C=y
CONFIG_CMD_MTD=y
CONFIG_CMD_USB=y
CONFIG_CMD_DHCP=y
CONFIG_CMD_MII=y
CONFIG_CMD_RNG=y
CONFIG_CMD_UBI=y
# CONFIG_OF_UPSTREAM is not set
CONFIG_OF_EMBED=y
CONFIG_ENV_IS_IN_SPI_FLASH=y
CONFIG_NET_RANDOM_ETHADDR=y
CONFIG_GPIO_HOG=y
CONFIG_MSM_GPIO=y
CONFIG_DM_I2C=y
CONFIG_SYS_I2C_QUP=y
# CONFIG_INPUT is not set
CONFIG_MISC=y
# CONFIG_MMC is not set
CONFIG_MTD=y
CONFIG_DM_MTD=y
CONFIG_DM_SPI_FLASH=y
CONFIG_SPI_FLASH_BAR=y
CONFIG_SPI_FLASH_WINBOND=y
# CONFIG_SPI_FLASH_USE_4K_SECTORS is not set
CONFIG_SPI_FLASH_MTD=y
CONFIG_PHY_QCA807X=y
CONFIG_DM_MDIO=y
CONFIG_PHY_GIGE=y
CONFIG_ESSEDMA=y
CONFIG_MDIO_IPQ4019=y
CONFIG_PHY=y
CONFIG_PHY_QCOM_IPQ4019_USB=y
CONFIG_POWER_DOMAIN=y
CONFIG_DM_RNG=y
CONFIG_RNG_MSM=y
CONFIG_DEBUG_UART_SHIFT=2
CONFIG_DEBUG_UART_ANNOUNCE=y
CONFIG_MSM_SERIAL=y
CONFIG_SPI=y
CONFIG_DM_SPI=y
CONFIG_SPI_QUP=y
CONFIG_SYSRESET=y
CONFIG_SYSRESET_QCOM_PSHOLD=y
CONFIG_USB=y
CONFIG_USB_XHCI_HCD=y
CONFIG_USB_DWC3=y
CONFIG_USB_DWC3_GENERIC=y
CONFIG_USB_HOST_ETHER=y
CONFIG_USB_ETHER_RTL8152=y
# CONFIG_SHA256 is not set
# CONFIG_EFI_LOADER is not set
```

## configs/mvebu_tn48m-88f7040_defconfig
```kconfig
CONFIG_ARM=y
CONFIG_ARCH_CPU_INIT=y
CONFIG_ARCH_MVEBU=y
CONFIG_SYS_TEXT_BASE=0x00000000
CONFIG_NR_DRAM_BANKS=2
CONFIG_TARGET_MVEBU_ARMADA_8K=y
CONFIG_ENV_SIZE=0x10000
CONFIG_ENV_OFFSET=0x3f0000
CONFIG_ENV_SECT_SIZE=0x10000
CONFIG_DM_GPIO=y
CONFIG_DEFAULT_DEVICE_TREE="armada-7040-tn48m"
CONFIG_DEBUG_UART_BASE=0xf0512000
CONFIG_DEBUG_UART_CLOCK=200000000
CONFIG_SYS_LOAD_ADDR=0x00800000
CONFIG_DEBUG_UART=y
CONFIG_AHCI=y
CONFIG_DISTRO_DEFAULTS=y
# CONFIG_SYS_MALLOC_CLEAR_ON_INIT is not set
CONFIG_FIT=y
CONFIG_FIT_VERBOSE=y
CONFIG_AUTOBOOT_KEYED=y
CONFIG_AUTOBOOT_PROMPT="Autoboot in %d seconds, to stop use 's' key\n"
CONFIG_AUTOBOOT_STOP_STR="s"
CONFIG_AUTOBOOT_KEYED_CTRLC=y
CONFIG_USE_PREBOOT=y
CONFIG_SYS_CONSOLE_INFO_QUIET=y
# CONFIG_DISPLAY_CPUINFO is not set
# CONFIG_DISPLAY_BOARDINFO is not set
CONFIG_DISPLAY_BOARDINFO_LATE=y
CONFIG_ARCH_EARLY_INIT_R=y
CONFIG_BOARD_EARLY_INIT_F=y
CONFIG_CMD_TLV_EEPROM=y
CONFIG_CMD_EEPROM=y
CONFIG_SYS_I2C_EEPROM_ADDR_LEN=2
CONFIG_SYS_EEPROM_SIZE=8192
CONFIG_SYS_EEPROM_PAGE_WRITE_BITS=5
CONFIG_SYS_EEPROM_PAGE_WRITE_DELAY_MS=10
CONFIG_CMD_GPIO=y
CONFIG_CMD_GPT=y
# CONFIG_RANDOM_UUID is not set
CONFIG_CMD_I2C=y
CONFIG_CMD_MMC=y
CONFIG_CMD_MTD=y
CONFIG_CMD_PCI=y
CONFIG_CMD_SATA=y
CONFIG_CMD_USB=y
# CONFIG_CMD_SETEXPR is not set
CONFIG_CMD_TFTPPUT=y
CONFIG_CMD_CACHE=y
CONFIG_CMD_TIME=y
CONFIG_CMD_MVEBU_BUBT=y
CONFIG_CMD_REGULATOR=y
CONFIG_CMD_TPM=y
CONFIG_CMD_EXT4_WRITE=y
# CONFIG_ISO_PARTITION is not set
CONFIG_ENV_IS_IN_SPI_FLASH=y
CONFIG_SYS_RELOC_GD_ENV_ADDR=y
CONFIG_NET_RANDOM_ETHADDR=y
CONFIG_AHCI_MVEBU=y
CONFIG_GPIO_HOG=y
CONFIG_DM_PCA953X=y
CONFIG_DM_I2C=y
CONFIG_SYS_I2C_MVTWSI=y
CONFIG_LED=y
CONFIG_LED_GPIO=y
CONFIG_MISC=y
CONFIG_I2C_EEPROM=y
CONFIG_SYS_I2C_EEPROM_ADDR=0x56
CONFIG_SYS_I2C_EEPROM_ADDR_OVERFLOW=0
CONFIG_MMC_SDHCI=y
CONFIG_MMC_SDHCI_XENON=y
CONFIG_MTD=y
CONFIG_DM_MTD=y
CONFIG_SF_DEFAULT_MODE=0
CONFIG_SPI_FLASH_SFDP_SUPPORT=y
CONFIG_SPI_FLASH_WINBOND=y
# CONFIG_SPI_FLASH_USE_4K_SECTORS is not set
CONFIG_SPI_FLASH_MTD=y
CONFIG_PHY_MARVELL=y
CONFIG_PHY_GIGE=y
CONFIG_MVPP2=y
CONFIG_RGMII=y
CONFIG_PCI=y
CONFIG_PCIE_DW_MVEBU=y
CONFIG_PHY=y
CONFIG_MVEBU_COMPHY_SUPPORT=y
CONFIG_PINCTRL=y
CONFIG_PINCTRL_ARMADA_8K=y
CONFIG_DM_REGULATOR_FIXED=y
CONFIG_DM_RTC=y
CONFIG_RTC_ARMADA38X=y
CONFIG_RTC_RX8010SJ=y
CONFIG_DEBUG_UART_SHIFT=2
CONFIG_DEBUG_UART_ANNOUNCE=y
CONFIG_SYS_NS16550=y
CONFIG_KIRKWOOD_SPI=y
# CONFIG_TPM_V1 is not set
CONFIG_TPM2_TIS_SPI=y
CONFIG_USB=y
CONFIG_USB_XHCI_HCD=y
CONFIG_USB_EHCI_HCD=y
CONFIG_TPM=y
# CONFIG_EFI_LOADER is not set
```

## configs/sparx5_pcb134_emmc_defconfig
```kconfig
CONFIG_ARM=y
CONFIG_COUNTER_FREQUENCY=250000000
CONFIG_ARCH_SPARX5=y
CONFIG_SYS_TEXT_BASE=0x0
CONFIG_SYS_MALLOC_LEN=0x800000
CONFIG_NR_DRAM_BANKS=1
CONFIG_ENV_SIZE=0x2000
CONFIG_ENV_OFFSET=0x100000
CONFIG_ENV_SECT_SIZE=0x40000
CONFIG_DEFAULT_DEVICE_TREE="sparx5_pcb134_emmc"
CONFIG_DDR_FIREANT_PCB134=y
CONFIG_FIREANT_SYMREG=y
CONFIG_DEBUG_UART_BASE=0x600100000
CONFIG_DEBUG_UART_CLOCK=250000000
CONFIG_DEBUG_UART_BOARD_INIT=y
CONFIG_ENV_OFFSET_REDUND=0x140000
# CONFIG_PSCI_RESET is not set
CONFIG_SYS_LOAD_ADDR=0x740000000
CONFIG_DEBUG_UART=y
CONFIG_DISTRO_DEFAULTS=y
CONFIG_HAS_CUSTOM_SYS_INIT_SP_ADDR=y
CONFIG_CUSTOM_SYS_INIT_SP_ADDR=0x708000000
CONFIG_FIT=y
CONFIG_FIT_VERBOSE=y
CONFIG_BOOTSTD_BOOTCOMMAND=y
CONFIG_BOOTCOMMAND="run distro_bootcmd"
CONFIG_LOG=y
CONFIG_EVENT=y
CONFIG_EVENT_DYNAMIC=y
CONFIG_CMD_CLK=y
CONFIG_CMD_GPIO=y
CONFIG_CMD_GPT=y
CONFIG_CMD_GPT_RENAME=y
CONFIG_CMD_I2C=y
CONFIG_CMD_MMC=y
CONFIG_CMD_MTD=y
CONFIG_CMD_TEMPERATURE=y
CONFIG_MMC_SPEED_MODE_SET=y
# CONFIG_ISO_PARTITION is not set
CONFIG_PARTITION_TYPE_GUID=y
CONFIG_ENV_IS_IN_SPI_FLASH=y
CONFIG_SYS_REDUNDAND_ENVIRONMENT=y
CONFIG_NET_RANDOM_ETHADDR=y
CONFIG_DM_EVENT=y
CONFIG_DM_I2C=y
CONFIG_SYS_I2C_DW=y
# CONFIG_INPUT is not set
CONFIG_LED=y
CONFIG_LED_GPIO=y
CONFIG_MMC_SDHCI=y
CONFIG_MMC_SDHCI_ADMA=y
CONFIG_MMC_SDHCI_SPARX5=y
CONFIG_MTD=y
CONFIG_DM_MTD=y
CONFIG_DM_SPI_FLASH=y
CONFIG_SPI_FLASH_SFDP_SUPPORT=y
CONFIG_SPI_FLASH_MACRONIX=y
CONFIG_SPI_FLASH_MTD=y
CONFIG_PHY_VITESSE=y
CONFIG_DM_MDIO=y
CONFIG_PHY_GIGE=y
CONFIG_MSCC_MIIM=y
CONFIG_MSCC_SPARX5_SWITCH=y
CONFIG_PINCONF=y
# CONFIG_POWER is not set
CONFIG_DM_RESET=y
CONFIG_RESET_SPARX5=y
CONFIG_DEBUG_UART_SHIFT=2
CONFIG_DEBUG_UART_ANNOUNCE=y
CONFIG_SYSRESET=y
CONFIG_SYSRESET_GPIO=y
# CONFIG_EFI_LOADER is not set
```
